#include "hal_data.h"
#include "dev_rgb_driver.h"

//#define DEBUG_KEEPING
#define DEBUG_RGB_API

#ifdef DEBUG_RGB_API
rgb_set_t g_rgb_set[RGB_NUM];
#endif

/*******************************************************************************************************************//**
 * main() is generated by the RA Configuration editor and is used to generate threads if an RTOS is used.  This function
 * is called by main() when no RTOS is used.
 **********************************************************************************************************************/
void hal_entry(void)
{
    /* TODO: add your own code here */
#ifdef DEBUG_KEEPING
    static uint8_t flag = 0;
#endif

    R_IOPORT_Open (&g_ioport_ctrl, &g_bsp_pin_cfg);
#ifdef DEBUG_RGB_API
        RGB_Init(RGB_OBJECT_0);
        RGB_Init(RGB_OBJECT_1);
        RGB_Init(RGB_OBJECT_2);
#endif

    while (1)
    {
#ifdef DEBUG_RGB_API
        RGB_ColorBrightSet(&g_rgb_set[RGB_OBJECT_0], RGB_OBJECT_0, RGB_COLOR_WHITE, 5);
#endif
#ifdef DEBUG_YELLOW
        R_IOPORT_PinWrite (&g_ioport_ctrl, RGB_PIN_RED, BSP_IO_LEVEL_HIGH);
        R_BSP_SoftwareDelay (4000, BSP_DELAY_UNITS_MICROSECONDS);
        R_IOPORT_PinWrite (&g_ioport_ctrl, RGB_PIN_GREEN, BSP_IO_LEVEL_HIGH);
        R_BSP_SoftwareDelay (1000, BSP_DELAY_UNITS_MICROSECONDS);
        R_IOPORT_PinWrite (&g_ioport_ctrl, RGB_PIN_RED, BSP_IO_LEVEL_LOW);
        R_IOPORT_PinWrite (&g_ioport_ctrl, RGB_PIN_GREEN, BSP_IO_LEVEL_LOW);
        R_BSP_SoftwareDelay (5000, BSP_DELAY_UNITS_MICROSECONDS);
#endif

#ifdef DEBUG_KEEPING
        if(flag == 0)
        {
            for(uint16_t i = 0; i < 100; i++)
            {

                R_IOPORT_PinWrite(&g_ioport_ctrl, RGB_PIN_GREEN, BSP_IO_LEVEL_HIGH);
                R_BSP_SoftwareDelay(500, BSP_DELAY_UNITS_MICROSECONDS);
                R_IOPORT_PinWrite(&g_ioport_ctrl, RGB_PIN_GREEN, BSP_IO_LEVEL_LOW);
                R_BSP_SoftwareDelay(9500, BSP_DELAY_UNITS_MICROSECONDS);
            }
            flag = 1;
        }
        if(flag == 1)
        {
            R_BSP_SoftwareDelay(1, BSP_DELAY_UNITS_SECONDS);
            flag = 0;
        }
#endif
    }
#if BSP_TZ_SECURE_BUILD
    /* Enter non-secure code */
    R_BSP_NonSecureEnter();
#endif
}

#if BSP_TZ_SECURE_BUILD

FSP_CPP_HEADER
BSP_CMSE_NONSECURE_ENTRY void template_nonsecure_callable ();

/* Trustzone Secure Projects require at least one nonsecure callable function in order to build (Remove this if it is not required to build). */
BSP_CMSE_NONSECURE_ENTRY void template_nonsecure_callable ()
{

}
FSP_CPP_FOOTER

#endif
