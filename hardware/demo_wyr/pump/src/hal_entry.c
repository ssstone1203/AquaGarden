#include "hal_data.h"
#include "pump_drv8870.h"

/*******************************************************************************************************************//**
 * 定时抽水：上电先抽一次 → 停 PUMP_INTERVAL_MS → 再抽 → … 共 PUMP_CYCLES 次 → 永久停泵空转。
 
 * PUMP_DRIVE_MODE：0=全速直流；1=仅 IN2 硬件 PWM（GPT，pump_drv8870_set_power）；2=软件时间平均（非硬件 PWM）。
 
 * 要一直重复抽把 PUMP_LOOP_FOREVER 改为 1。
 **********************************************************************************************************************/

#define PUMP_DRIVE_FULL_DC   0U
#define PUMP_DRIVE_GPT_PWM   1U
#define PUMP_DRIVE_TIME_AVG  2U

/** 默认 GPT PWM；只改 PUMP_SPEED_PERCENT 即可调转速 */
#define PUMP_DRIVE_MODE      PUMP_DRIVE_GPT_PWM

/**
 * 总共抽水几次（第一次上电立刻抽，其后每次先停再等 PUMP_INTERVAL_MS）。
 */
#define PUMP_CYCLES           3U

/** 1 = 上面次数跑完后，从第一轮再无限循环；0 = 跑完就永久停 */
#define PUMP_LOOP_FOREVER     0

/** 两次抽水之间停泵等待（毫秒）；第一次之前不等待 */
#define PUMP_INTERVAL_MS      3000U

/** 单次抽水总时间（毫秒） */
#define PUMP_BURST_MS         1000U

/**
 * PUMP_SPEED_PERCENT(GPT_PWM)：1–100，占空越大平均转速越高（IN1=1，IN2 上 PWM，关断半周为制动，符合 DRV8870 手册）。
 * TIME_AVG：1–99 有效；FULL_DC 时忽略。
 */
#define PUMP_SPEED_PERCENT    50U

/*******************************************************************************************************************//**
 * main() is generated by the RA Configuration editor and is used to generate threads if an RTOS is used.  This function
 * is called by main() when no RTOS is used.
 **********************************************************************************************************************/
void hal_entry(void)
{
    pump_drv8870_init();

#if BSP_TZ_SECURE_BUILD
    /* Enter non-secure code */
    R_BSP_NonSecureEnter();
#endif

    do
    {
        for (uint32_t i = 0U; i < PUMP_CYCLES; i++)
        {
            if (i > 0U)
            {
                pump_drv8870_stop();
                R_BSP_SoftwareDelay(PUMP_INTERVAL_MS, BSP_DELAY_UNITS_MILLISECONDS);
            }

#if PUMP_DRIVE_MODE == PUMP_DRIVE_FULL_DC
            pump_drv8870_run_forward_dc();
            R_BSP_SoftwareDelay(PUMP_BURST_MS, BSP_DELAY_UNITS_MILLISECONDS);
#elif PUMP_DRIVE_MODE == PUMP_DRIVE_GPT_PWM
            pump_drv8870_set_power((uint8_t) PUMP_SPEED_PERCENT);
            R_BSP_SoftwareDelay(PUMP_BURST_MS, BSP_DELAY_UNITS_MILLISECONDS);
#elif PUMP_DRIVE_MODE == PUMP_DRIVE_TIME_AVG
            pump_drv8870_run_dc_time_average((uint8_t) PUMP_SPEED_PERCENT, PUMP_BURST_MS);
#else
#error "Invalid PUMP_DRIVE_MODE (use PUMP_DRIVE_FULL_DC, PUMP_DRIVE_GPT_PWM, or PUMP_DRIVE_TIME_AVG)"
#endif
        }

        pump_drv8870_stop();
    } while (PUMP_LOOP_FOREVER != 0);

    while (1)
    {
        R_BSP_SoftwareDelay(1000U, BSP_DELAY_UNITS_MILLISECONDS);
    }
}

#if BSP_TZ_SECURE_BUILD

FSP_CPP_HEADER
BSP_CMSE_NONSECURE_ENTRY void template_nonsecure_callable ();

/* Trustzone Secure Projects require at least one nonsecure callable function in order to build (Remove this if it is not required to build). */
BSP_CMSE_NONSECURE_ENTRY void template_nonsecure_callable ()
{

}
FSP_CPP_FOOTER

#endif
