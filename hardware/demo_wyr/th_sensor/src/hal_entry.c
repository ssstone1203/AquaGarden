#include "hal_data.h"
#include "sht30.h"

/* 本板 ADDR 接 GND，7 位地址为 0x44 */
#define SHT30_I2C_ADDR_7BIT    (0x44U)

/*******************************************************************************************************************//**
 * main() is generated by the RA Configuration editor and is used to generate threads if an RTOS is used.  This function
 * is called by main() when no RTOS is used.
 **********************************************************************************************************************/
void hal_entry(void)
{
    fsp_err_t err = sht30_init(&g_i2c_master0, SHT30_I2C_ADDR_7BIT);
    if (FSP_SUCCESS != err)
    {
        while (1)
        {
            /* 调试：Watch g_sht30_last_status / 在此打断点 */
            ;
        }
    }

#if BSP_TZ_SECURE_BUILD
    /* Enter non-secure code */
    R_BSP_NonSecureEnter();
#endif

    while (1)
    {
        /* Watch: g_sht30_temperature_c, g_sht30_temperature_f, g_sht30_humidity_rh,
         *        g_sht30_temperature_raw, g_sht30_humidity_raw,
         *        g_sht30_last_status, g_sht30_last_i2c_stage
         * 量程宏：SHT30_*_SPEC_* / SHT30_*_RECOMMENDED_*（见 sht30.h）
         */
        (void) sht30_measure_single_shot(NULL, NULL, NULL, false);
        R_BSP_SoftwareDelay(500U, BSP_DELAY_UNITS_MILLISECONDS);
    }
}

#if BSP_TZ_SECURE_BUILD

FSP_CPP_HEADER
BSP_CMSE_NONSECURE_ENTRY void template_nonsecure_callable ();

/* Trustzone Secure Projects require at least one nonsecure callable function in order to build (Remove this if it is not required to build). */
BSP_CMSE_NONSECURE_ENTRY void template_nonsecure_callable ()
{

}
FSP_CPP_FOOTER

#endif
