#include "hal_data.h"
#include "pressure_sensor.h"
#include <stdio.h>

/*******************************************************************************************************************//**
 * main() is generated by the RA Configuration editor and is used to generate threads if an RTOS is used.  This function
 * is called by main() when no RTOS is used.
 **********************************************************************************************************************/
void hal_entry(void)
{
    fsp_err_t err = FSP_SUCCESS;

    /* 存放 3 路传感器的 ADC 原始值与压力值 */
    uint16_t adc_raw_value[PRESSURE_SENSOR_NUM]    = {0};
    float    pressure_value_kg[PRESSURE_SENSOR_NUM] = {0.0f};

    /* 初始化由 FSP 生成的公共模块 */
    g_hal_init();

    /* 初始化压力传感器 (底层会初始化 ADC) */
    err = pressure_sensor_init();
    if (FSP_SUCCESS != err)
    {
        while (1)
        {
            /* 初始化失败，卡在这里方便调试 */
        }
    }

    while (1)
    {
        /* 扫描模式下一次性采集三路 PS0/PS1/PS2 */
        err = pressure_sensor_read_all(adc_raw_value, pressure_value_kg);
        if (FSP_SUCCESS == err)
        {
            /* 打开下方 printf，可以在串口看到三路原始值和压力值 */
            //printf("PS0: ADC=%u, P=%.3f kg;  PS1: ADC=%u, P=%.3f kg;  PS2: ADC=%u, P=%.3f kg\r\n",
            //       adc_raw_value[0], pressure_value_kg[0],
            //       adc_raw_value[1], pressure_value_kg[1],
            //       adc_raw_value[2], pressure_value_kg[2]);
        }

        /* 采样周期，根据需要调整，这里为 100ms */
        R_BSP_SoftwareDelay(100U, BSP_DELAY_UNITS_MILLISECONDS);

#if BSP_TZ_SECURE_BUILD
        /* Enter non-secure code */
        R_BSP_NonSecureEnter();
#endif
    }
}

#if BSP_TZ_SECURE_BUILD

FSP_CPP_HEADER
BSP_CMSE_NONSECURE_ENTRY void template_nonsecure_callable ();

/* Trustzone Secure Projects require at least one nonsecure callable function in order to build (Remove this if it is not required to build). */
BSP_CMSE_NONSECURE_ENTRY void template_nonsecure_callable ()
{

}
FSP_CPP_FOOTER

#endif
